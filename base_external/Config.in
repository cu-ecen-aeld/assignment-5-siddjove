## base_external/configs/aesd_qemu_defconfig
```kconfig
BR2_aarch64=y
BR2_KERNEL_HEADERS_6_6=y
BR2_TARGET_GENERIC_ROOT_PASSWD="root"
BR2_LINUX_KERNEL=y
BR2_LINUX_KERNEL_USE_ARCH_DEFAULT_CONFIG=y
BR2_LINUX_KERNEL_IMAGE_TARGET_CUSTOM=y
BR2_LINUX_KERNEL_IMAGE_TARGET_NAME="Image"
BR2_LINUX_KERNEL_INSTALL_TARGET=y
BR2_PACKAGE_DROPBEAR=y
BR2_TARGET_ROOTFS_EXT4=y
BR2_TARGET_ROOTFS_EXT4_SIZE="1500M"
BR2_TARGET_ROOTFS_EXT4_MKE2FS_EXTRA="-O ^64bit -O extents -O uninit_bg -O dir_index -O has_journal"
```

## base_external/package/aesd-assignments/Config.in
```kconfig
config BR2_PACKAGE_AESD_ASSIGNMENTS
    bool "aesd-assignments"
    help
      This package pulls the assignments-3-and-later repo,
      builds the writer application using the Buildroot toolchain,
      installs the writer, finder.sh, finder-test.sh,
      and configuration files into the target root filesystem.
```

## base_external/package/aesd_assignments/Config.in
```kconfig
config BR2_PACKAGE_AESD_ASSIGNMENTS
    bool "aesd-assignments"
    help
      AESD assignments repository with finder, writer, and test scripts.
```
